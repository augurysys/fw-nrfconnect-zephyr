## dts/bindings/sensor/nxp,fxos8700-spi.yaml
```yaml
# Copyright (c) 2018, NXP
# SPDX-License-Identifier: Apache-2.0

title: AUGU_FXOS8700 6-axis accelerometer/magnetometer

description: |
    This is a representation of the AUGU_FXOS8700 6-axis accelerometer/magnetometer
    sensor

compatible: "nxp,augufxos8700"

include: spi-device.yaml

properties:
    reset-gpios:
      type: phandle-array
      required: false

    int1-gpios:
      type: phandle-array
      required: false

    int2-gpios:
      type: phandle-array
      required: false
```
